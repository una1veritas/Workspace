#include <rxduino.h>
#include "nokia_lcd.h"

#ifdef __GNUC__
  #ifdef CPU_IS_RX62N
    #include "iodefine_gcc62n.h"
  #endif
  #ifdef CPU_IS_RX63N
    #include "iodefine_gcc63n.h"
  #endif
#endif
#ifdef __RENESAS__
  #include "iodefine.h"
#endif

// (C) Copyright 2011 Tokushu Denshi Kairo Inc.

typedef enum {LCD6610, LCD6100,PCF8833}LCDtype;
LCDtype _type=LCD6610;
// S1D15G10にコマンドを送る

int _rows, _columns, _width, _height;
int	_row = 0;
int	_column = 0;
int	_foreground = 0x00FFFFFF;
int	_background = 0x00000000;

extern CSPI SPI;

static void	_window(int x, int y, int width, int height);		// Call this by "LCD_window" function
static void	_putp(int colour);		// Call this by "_putp" function

static void	NokiaLCD_command(int value);
static void	NokiaLCD_data(int value);

const unsigned char FONT8x8[97][8] = {
	{0x08,0x08,0x08,0x00,0x00,0x00,0x00,0x00,}, // columns, rows, num_bytes_per_char
	{0x00,0x00,0x00,0x00,0x00,0x00,0x00,0x00,}, // space 0x20
	{0x30,0x78,0x78,0x30,0x30,0x00,0x30,0x00,}, // !
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	{0x1C,0x36,0x36,0x1C,0x00,0x00,0x00,0x00,},
}; // DEL

static inline void NokiaLCD_CS_OUT()
{
#ifdef CPU_IS_RX62N
	PORT5.DDR.BYTE |= (1U << 1);
#endif
}

static inline void NokiaLCD_CS_H()
{
#ifdef CPU_IS_RX62N
	PORT5.DR.BYTE |= (1U << 1);
#endif
}

static inline void NokiaLCD_CS_L()
{
#ifdef CPU_IS_RX62N
	PORT5.DR.BYTE &= ~(1U << 1);
#endif
}

static inline void NokiaLCD_RES_OUT()
{
#ifdef CPU_IS_RX62N
	PORT5.DDR.BYTE |= (1U << 0);
#endif
}

static inline void NokiaLCD_RES_H()
{
#ifdef CPU_IS_RX62N
	PORT5.DR.BYTE |= (1U << 0);
#endif
}

static inline void NokiaLCD_RES_L()
{
#ifdef CPU_IS_RX62N
	PORT5.DR.BYTE &= ~(1U << 0);
#endif
}

void NokiaLCD_command(int value) {
	NokiaLCD_CS_L();
	SPI.transfer(value & 0xFF);
	NokiaLCD_CS_H();
}

void NokiaLCD_data(int value) {
	NokiaLCD_CS_L();
	SPI.transfer((value | 0x100));
	NokiaLCD_CS_H();
}

void NokiaLCD_reset(void) {
    NokiaLCD_CS_H();
    NokiaLCD_CS_OUT();
    NokiaLCD_CS_L();
    NokiaLCD_RES_H();
    NokiaLCD_RES_OUT();
    NokiaLCD_RES_H();
 
	// setup the SPI interface and bring display out of reset
	NokiaLCD_CS_H();		//_cs = 1;
	NokiaLCD_RES_L();		//_rst = 0;


	SPI.begin();
	SPI.port = SPI_PORT_CS0_DUINO;
	SPI.setBitLength(9);		//_spi.format(9);
	SPI.setClockDivider(SPI_CLOCK_DIV16);
	SPI.setBitOrder(MSBFIRST);		//_spi.format(9);
					//_spi.frequency(LCD_FREQUENCY);

	RSPI0.SPCMD0.WORD = 0x0800;	/* LSBF=0, SPB=7, BRDV=0, CPOL=1, CPHA=0 */
	RSPI0.SPBR.BYTE = 48000000UL/* =PCLK */ /2/21168000UL/* =SPI_CLK */-1;

	delay(1);	//wait_ms(1);
	NokiaLCD_RES_H();		//_rst = 1;
	delay(1);	//wait_ms(1);
	NokiaLCD_CS_L();		//_cs = 0;

    switch (_type) {
		case LCD6100:
			NokiaLCD_command(0xCA);	// display control
			NokiaLCD_data(0);
			NokiaLCD_data(32);
			NokiaLCD_data(0);
			NokiaLCD_command(0xBB);
			NokiaLCD_data(1);
			NokiaLCD_command(0xD1);	// oscillator on
			NokiaLCD_command(0x94);	// sleep out
			NokiaLCD_command(0x20);	// power control
			NokiaLCD_data(0x0F);
			NokiaLCD_command(0xA7);	// invert display
			NokiaLCD_command(0x81);	// Voltage control
			NokiaLCD_data(39);			// contrast setting: 0..63
			NokiaLCD_data(3);			// resistance ratio
			delay(1);		//wait_ms(1);
			NokiaLCD_command(0xBC);
			NokiaLCD_data(0);
			NokiaLCD_data(1);
			NokiaLCD_data(4);
			NokiaLCD_command(0xAF);	// turn on the display
			break;

		case LCD6610:
			NokiaLCD_command(0xCA);	// display control
			NokiaLCD_data(0);
			NokiaLCD_data(31);
			NokiaLCD_data(0);
			NokiaLCD_command(0xBB);
			NokiaLCD_data(1);
			NokiaLCD_command(0xD1);	// oscillator on
			NokiaLCD_command(0x94);	// sleep out
			NokiaLCD_command(0x20);	// power control
			NokiaLCD_data(0x0F);
			NokiaLCD_command(0xA7);	// invert display
			NokiaLCD_command(0x81);	// Voltage control
			NokiaLCD_data(39);			// contrast setting: 0..63
			NokiaLCD_data(3);			// resistance ratio
			delay(1);		//delay_ms(1);	//wait_ms(1);
			NokiaLCD_command(0xBC);
			NokiaLCD_data(0);
			NokiaLCD_data(0);
			NokiaLCD_data(2);
			NokiaLCD_command(0xAF);	// turn on the display
			break;
		case PCF8833:
			NokiaLCD_command(0x11);	// sleep out
			NokiaLCD_command(0x3A);	// column mode
			NokiaLCD_data(0x05);
			NokiaLCD_command(0x36);	// madctl
			NokiaLCD_data(0x60);		// vertical RAM, flip x
			NokiaLCD_command(0x25);	// setcon
			NokiaLCD_data(0x30);		// contrast 0x30
			delay(2);		//wait_ms(2);
			NokiaLCD_command(0x29);	//DISPON
			NokiaLCD_command(0x03);	//BSTRON
			break;
    }
    NokiaLCD_CS_H();	// _cs = 1;

    NokiaLCD_cls();
}


void _window(int x, int y, int width, int height) {
	int x1 = x + 2;
	int y1 = y + 0;
	int x2 = x1 + width - 1;
	int y2 = y1 + height - 1;

	switch (_type) {
		case LCD6100:
		case LCD6610:
			NokiaLCD_command(0x15); // column
			NokiaLCD_data(x1);
			NokiaLCD_data(x2);
			NokiaLCD_command(0x75); // row
			NokiaLCD_data(y1);
			NokiaLCD_data(y2);
			NokiaLCD_command(0x5C); // start write to ram
			break;
		case PCF8833:
			NokiaLCD_command(0x2A);  // column
			NokiaLCD_data(x1);
			NokiaLCD_data(x2);
			NokiaLCD_command(0x2B); // row
			NokiaLCD_data(y1);
			NokiaLCD_data(y2);
			NokiaLCD_command(0x2C); // start write to ram
			break;
	}
}

void _putp(int colour) {
	int gr = ((colour >> 20) & 0x0F)
			 | ((colour >> 8 ) & 0xF0);
	int nb = ((colour >> 4 ) & 0x0F);
	NokiaLCD_data(nb);
	NokiaLCD_data(gr);
}

void LCD_locate(int column, int row) {
	_column = column;
	_row = row;
}

void LCD_newline(void) {
	_column = 0;
	_row++;
	if (_row >= NokiaLCD_rows()) {
		_row = 0;
	}
}

int LCD_putc(int value) {
	int x = _column * 8;  // FIXME: Char sizes
	int y = _row * 8;

	NokiaLCD_bitblit(x + 1, y + 1, 8, 8, (char*)&(FONT8x8[value - 0x1F][0]));

	_column++;

	if (_column >= LCD_COLS) {
		_row++;
		_column = 0;
	}

	if (_row >= LCD_ROWS) {
		_row = 0;
	}

	return value;
}

void NokiaLCD_cls(void) {
	//TODO:
	//FIXME:
	NokiaLCD_fill(0, 0, LCD_WIDTH, LCD_HEIGHT, _background);
    _row = 0;
    _column = 0;
}


void NokiaLCD_window(int x, int y, int width, int height) {
    NokiaLCD_CS_L();	//_cs = 0;
    _window(x, y, width, height);
    NokiaLCD_CS_H();	// _cs = 1;
}

void NokiaLCD_putp(int colour) {
    NokiaLCD_CS_L();	//_cs = 0;
    _putp(colour);
    NokiaLCD_CS_H();	//_cs = 1;
}

void NokiaLCD_pixel(int x, int y, int colour) {
    NokiaLCD_CS_L();	// _cs = 0;
    _window(x, y, 1, 1);
    _putp(colour);
    NokiaLCD_CS_H();	// _cs = 1;
}

void NokiaLCD_fill(int x, int y, int width, int height, int colour) {
    NokiaLCD_CS_L();	//_cs = 0;
    _window(x, y, width, height);
    int i;
    switch (_type) {
        case LCD6100:
        case PCF8833:
            for (i=0; i<width*height; i++) {
                _putp(colour);
            }
            break;
        case LCD6610:
            for (i=0; i<width*height/2; i++) {
                int r4 = (colour >> (16 + 4)) & 0xF;
                int g4 = (colour >> (8 + 4)) & 0xF;
                int b4 = (colour >> (0 + 4)) & 0xF;
                int d1 = (r4 << 4) | g4;
                int d2 = (b4 << 4) | r4;
                int d3 = (g4 << 4) | b4;
                NokiaLCD_data(d1);
                NokiaLCD_data(d2);
                NokiaLCD_data(d3);
            }
            break;
    }
    _window(0, 0, LCD_WIDTH, LCD_HEIGHT);
    NokiaLCD_CS_L();	//_cs = 1;
}

void NokiaLCD_blit(int x, int y, int width, int height, const int* colour)
{
	int i;
	NokiaLCD_CS_L();	//_cs = 0;
	_window(x, y, width, height);

	switch (_type) {
	case LCD6100:
	case PCF8833:
		for (i=0; i<width*height; i++) {
			 _putp(colour[i]);
		 }
		 break;
	case LCD6610:
		for (i=0; i<width*height/2; i++) {
			int r41 = (colour[i*2] >> (16 + 4)) & 0xF;
			int g41 = (colour[i*2] >> (8 + 4)) & 0xF;
			int b41 = (colour[i*2] >> (0 + 4)) & 0xF;

			int r42 = (colour[i*2+1] >> (16 + 4)) & 0xF;
			int g42 = (colour[i*2+1] >> (8 + 4)) & 0xF;
			int b42 = (colour[i*2+1] >> (0 + 4)) & 0xF;
			int d1 = (r41 << 4) | g41;
			int d2 = (b41 << 4) | r42;
			int d3 = (g42 << 4) | b42;
			NokiaLCD_data(d1);
			NokiaLCD_data(d2);
			NokiaLCD_data(d3);
		}
		break;
	 }
	_window(0, 0, LCD_WIDTH, LCD_HEIGHT);
	NokiaLCD_CS_H();	//_cs = 1;
}

void NokiaLCD_bitblit(int x, int y, int width, int height, const char* bitstream)
{
	int i;
	NokiaLCD_CS_L();	//_cs = 0;
	_window(x, y, width, height);

	switch (_type) {
		case LCD6100:
		case PCF8833:
			for (i=0; i<height*width; i++) {
				int byte = i / 8;
				int bit = i % 8;
				int colour = ((bitstream[byte] << bit) & 0x80) ? _foreground : _background;
				_putp(colour);
			}
			break;
		case LCD6610:
			for(i=0; i<height*width/2; i++) {
				int byte1 = (i*2) / 8;
				int bit1 = (i*2) % 8;
				int colour1 = ((bitstream[byte1] << bit1) & 0x80) ? _foreground : _background;
				int byte2 = (i*2+1) / 8;
				int bit2 = (i*2+1) % 8;
				int colour2 = ((bitstream[byte2] << bit2) & 0x80) ? _foreground : _background;

				int r41 = (colour1 >> (16 + 4)) & 0xF;
				int g41 = (colour1 >> (8 + 4)) & 0xF;
				int b41 = (colour1 >> (0 + 4)) & 0xF;

				int r42 = (colour2 >> (16 + 4)) & 0xF;
				int g42 = (colour2 >> (8 + 4)) & 0xF;
				int b42 = (colour2 >> (0 + 4)) & 0xF;
				int d1 = (r41 << 4) | g41;
				int d2 = (b41 << 4) | r42;
				int d3 = (g42 << 4) | b42;
				NokiaLCD_data(d1);
				NokiaLCD_data(d2);
				NokiaLCD_data(d3);
			}
			break;
	 }
	_window(0, 0, _width, _height);
	NokiaLCD_CS_H();	//_cs = 1;
}

void NokiaLCD_foreground(int c) {
    _foreground = c;
}

void NokiaLCD_background(int c) {
    _background = c;
}

int NokiaLCD_width() {
    return LCD_WIDTH;
}

int NokiaLCD_height() {
    return LCD_HEIGHT;
}

int NokiaLCD_columns() {
    return LCD_COLS;
}

int NokiaLCD_rows() {
    return LCD_ROWS;
}
